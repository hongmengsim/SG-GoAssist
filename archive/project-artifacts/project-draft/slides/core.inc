const guide='Official guideline: ../SGBTGC 2026 - IHL Updates 18 Aug 2026.pdf, pp. 16–18 (18 August 2026 update).';
const timed=(seconds,script,sources)=>`${guide}\n5-minute core presentation. Planned speaking time: ${seconds} seconds.\nPresenter cue: ${script}\n${sources}`;
{
const s=p.slides.add();s.background.fill=C.navy;text(s,'SG GoAssist',66,65,1140,92,70,C.white,true);text(s,'Autonomous Passenger Assistance System',69,178,1135,58,33,C.white);text(s,'National University of Singapore (NUS)',69,265,1135,45,29,'#8ED4D0');text(s,'Team: SG GoAssist (provisional)',69,327,1135,43,27,C.white);text(s,'Members: ______________________________',69,481,1135,39,24,C.white);text(s,'Staff-in-charge: __________________________',69,536,1135,40,24,C.white);text(s,'Draft progress as of 25 September 2026',69,625,1135,34,23,'#BBD0D7');s.speakerNotes.textFrame.setText(timed(15,'Introduce the project and institution. Confirm the final team name, members and staff-in-charge before submission.',outline+', p. 1. Institution supplied for this draft. The team name remains provisional.\nCore slides 1–8 total 300 seconds. All following slides are Q&A appendices, outside the timed presentation. A separate video of up to 5 minutes is allowed and remains to be produced. Presenter: ____________________'));}
{
const s=slide('Problem and project objective',timed(30,'Explain that requests must lead to understandable, verified assistance. Include passengers who ask for extra time or guidance without a visible mobility aid. State the controlled-prototype boundary.',outline+', pp. 1–3, 13.'),'A controlled prototype for accessible boarding and alighting');paras(s,[['Passenger need','A clear way to request help and understand when boarding or alighting can proceed.'],['Project objective','Complete one repeatable journey from explicit request to acknowledgement, safe assistance and verified completion.'],['Inclusive scope','Ramp assistance, extra time and audio, visual or haptic guidance based on the passenger’s choice.']],66,208,1148,124);}
{
const s=slide('Alternatives and selected method',timed(40,'Compare design tradeoffs, not measured impact. Manual assistance provides an operator baseline. Camera-only triggering cannot establish consent. Explain why explicit intent with perception and deterministic checks is the selected prototype method.',outline+', pp. 2, 5–9, 13. Comparison is the team design rationale, not a completed experimental comparison.'));table(s,[['Approach','Useful feature','Tradeoff / design decision'],['Manual assistance','Human judgement and flexible intervention','Use as the baseline. It requires an operator to coordinate each journey.'],['Camera-only trigger','Observable assistance cues without app input','A cue cannot establish a request or consent. Reject as ramp authority.'],['Explicit request with sensor checks','Passenger control plus verified system response','Selected method. Adds integration and calibration work.']],[290,360,498],187,386,24);text(s,'ML interprets uncertain scenes. Fixed rules and physical sensors retain safety vetoes.',66,609,1135,61,27,C.teal,true);}
{
const s=slide('Integrated system and safety principle',timed(40,'Walk through the four layers. Emphasize that perception supports a confirmed request. The controller repeats safety checks during movement and verifies deployed and stowed positions.',outline+', pp. 3, 9; docs/grand-challenge-integrated-prototype.md, Safety policy; docs/task-requirements-traceability.md. Software logic exists, but physical integration acceptance remains incomplete.'));table(s,[['Layer','Role in the assistance journey'],['App and stop unit','Record request, confirmation and cancellation for the selected bus.'],['Camera and distance sensing','Report observable cues, occupied zones and sensor health.'],['Backend and operator','Manage the case, expose reasons and apply safety rules.'],['Mock-bus controller','Repeat local interlocks and verify ramp limit-switch state.']],[340,808],180,348,26);text(s,'Confirmed intent + fresh safety inputs + verified position',66,563,1140,49,33,C.teal,true);text(s,'Uncertainty blocks movement. Completion requires a verified stowed ramp.',66,622,1140,43,27);}
{
const s=slide('Original project contributions',timed(40,'Separate reused technologies from the team work. The proposed contribution is the combined intent-to-outcome assistance workflow and its safety/feedback integration. Avoid world-first claims. Judges assess only original elements, so retain implementation and authorship evidence.',guide+' Originality and Creativity carries 30%. '+outline+', pp. 2–3, 9; docs/grand-challenge-integrated-prototype.md; cad/VALIDATION_v2.md. These are scoped project contributions, not a prior-art novelty assessment.'),'Originality claim is limited to the team’s design and integration work');paras(s,[['Intent and assistance workflow','Retain passenger choice across request, confirmation, cancellation, actuation and verified completion.'],['Safety and accessible feedback integration','Connect case decisions, local interlocks, position checks and passenger/operator status in one auditable loop.'],['Centre-door mechanism concept','Develop the door, ramp and boarding-fixture CAD arrangement and operating sequence for the prototype.']],66,204,1148,114);text(s,'Reused foundations: ESP32, ToF sensors, pretrained detection and ArUco methods.',66,620,1135,48,25,C.muted);}
{
const s=slide('Progress supported by current evidence',timed(60,'Distinguish software, CAD and the sensor bench. Software has documented automated tests and fixture/mock operation. The CAD check is discrete packaging evidence. Explain the 27 valid sensor samples and that accuracy is unverified. Name the VL53L0X versus VL53L5CX mismatch and the remaining physical and ML evidence.', 'Sources: docs/feature-readiness-matrix.md; docs/grand-challenge-integrated-prototype.md; cad/VALIDATION_v2.md; hardware/esp32-s3-tof-test/README.md; artifacts/apas-tof-build/serial-powercycle-test.txt; hardware/edge-observer/ml1/README.md. Image: cad/Punggol_WeRide_Robobus_v2_deployed.png, project CAD render. No full software rerun or physical integration trial performed for this draft.'));await img(s,'cad/Punggol_WeRide_Robobus_v2_deployed.png',55,172,588,390);paras(s,[['Software','App, backend and operator flow. Documented mock and automated-test evidence.'],['CAD','73 sampled poses. Zero moving-part intersections in a discrete check.'],['Sensor bench','27 consecutive valid VL53L0X samples, 30–136 mm after power cycle.']],685,175,525,124);text(s,'Physical integration and measured ML performance remain incomplete.',66,591,1135,44,28,C.teal,true);text(s,'Sensor accuracy remains unverified. Current hardware differs from the 8×8 firmware sensor.',66,642,1135,41,23,C.muted);}
{
const s=slide('Validation plan and results',timed(40,'State these are planned targets. Blank fields await measured results. Compare the same journey with manual assistance and collect consented feedback. Explain that physical trials must demonstrate both successful assistance and safe failure responses.',outline+', pp. 12–13. Original targets shown. Later docs/task-requirements-traceability.md adds 30 requests per explicit source and acknowledgement P95 under 2 seconds. Confirm the final protocol. Results intentionally blank.'));table(s,[['Test','Original target','Result'],['Request','20/20 delivery trials, acknowledgement within 2 s',''],['Assistance cue','At least 90% wheelchair/PMA recall, at least 10 FPS',''],['Safety and actuation','Zero missed obstructions. 50 cycles without binding',''],['Docking and journey','10 docking trials. At least 9/10 cold-start journeys',''],['Dwell','No premature CLEAR in defined tests','']],[260,680,208],183,395,23);text(s,'Impact and accessibility findings:',66,609,620,36,25,C.teal,true);text(s,'____________________________________________',66,652,1120,33,24,C.muted);}
{
const s=slide('Remaining work and competition milestones',timed(35,'Close with the next milestone: a repeatable physical journey supported by measured evidence. State official dates carefully. The report and poster are due in September, while slideshow/video submission is in October. The organiser labels dates tentative.',guide+' pp. 16–17. Action-plan 27 September content freeze is an internal planning target, not an organiser deadline. Main event permits 5-minute presentation, up to 5-minute video and 5-minute Q&A. Separate video remains incomplete.'));text(s,'Next: resolve sensor choice, integrate hardware and collect validation evidence.',66,158,1135,79,30,C.teal,true);table(s,[['Official milestone','Date'],['Project report and display-poster artwork','30 September 2026'],['Pre-event prototype showcase (25 minutes)','7 October 2026'],['Main-event slideshow and video submission','15 October 2026'],['Main event: presentation, video and Q&A','24 October 2026']],[825,323],256,296,25);text(s,'Dates are tentative. Main-event format: 5 min talk, up to 5 min video, 5 min Q&A.',66,587,1140,67,25,C.muted);text(s,'Core presentation ends here. Supporting slides follow for Q&A.',66,654,1140,33,23,C.teal,true);}
